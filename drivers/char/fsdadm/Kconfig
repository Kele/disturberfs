## drivers/char/fsdadm/Kconfig
```kconfig
menuconfig FSDADM
	tristate "Filesystem disturber driver"
	depends on EXPERIMENTAL
	depends on HOOK_FS
	---help---
	  TODO
```

## fs/hookfs/Kconfig
```kconfig
config HOOK_FS 
	tristate "hookfs (EXPERIMENTAL)"
	depends on EXPERIMENTAL
	help
	  hookfs is based on wrapfs <http://wrapfs.filesystems.org>
	  It allows installing hooks in filesystem calls.
```
